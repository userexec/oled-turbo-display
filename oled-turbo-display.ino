/**************************************************************************
OLED Turbo Button
Turbo button display replacement for IBM PC Compatibles
Using Adafruit SSD1306 B/W OLED panel at 128x64px
Fits into your case where a Turbo display normally would

Shows an icon for your processor (or 8088 if Turbo activated) on startup,
and whenever you toggle the Turbo button. Changes to a star field
screensaver after 10 seconds.

Requires a jumper with a pulldown resistor from the positive
lead on the case's Turbo LED to the digital input of your
choice (default 2) on the Arduino.

Create a logo for your processor using image2cpp
128x64 in Paint, monochrome bitmap format
Draw mode Horizontal, 1 bit per pixel
http://javl.github.io/image2cpp/
 **************************************************************************/

#include <SPI.h>
#include <Wire.h>
#include <Adafruit_GFX.h>
#include <Adafruit_SSD1306.h>

#define SCREEN_WIDTH 128 // OLED display width, in pixels
#define SCREEN_HEIGHT 64 // OLED display height, in pixels

// Declaration for an SSD1306 display connected to I2C (SDA, SCL pins)
// The pins for I2C are defined by the Wire-library. 
// On an arduino UNO:       A4(SDA), A5(SCL)
// On an arduino MEGA 2560: 20(SDA), 21(SCL)
// On an arduino LEONARDO:   2(SDA),  3(SCL), ...
#define OLED_RESET     4 // Reset pin # (or -1 if sharing Arduino reset pin)
#define SCREEN_ADDRESS 0x3C ///< See datasheet for Address; 0x3D for 128x64, 0x3C for 128x32
Adafruit_SSD1306 display(SCREEN_WIDTH, SCREEN_HEIGHT, &Wire, OLED_RESET);


////////////////////////////////////////////////////////////////
//////////////////////////////////////////////////////////////// SETTINGS
////////////////////////////////////////////////////////////////

// Solder a male jumper wire with a pulldown resistor to ground from the positive lead of the Turbo LED.
// When Turbo light is on, this Arduino pin will be HIGH. When it is off, the pin will be pulled LOW.
int turboPin = 2;

// How long to show the icon when the Turbo button is toggled (approximation in seconds)
int showIconFor = 10;


////////////////////////////////////////////////////////////////
//////////////////////////////////////////////////////////////// PROCESSOR ICONS
////////////////////////////////////////////////////////////////

// TURBO OFF ICON - Swap this array with the icon to show when the turbo button is disabled (default i8088 icon)
const unsigned char turbo_off [] PROGMEM = {
  0x00, 0x00, 0x00, 0x00, 0x00, 0x00, 0x00, 0x00, 0x00, 0x00, 0x00, 0x00, 0x00, 0x00, 0x00, 0x00, 
	0x00, 0x00, 0x00, 0x00, 0x00, 0x00, 0x00, 0x00, 0x00, 0x00, 0x00, 0x00, 0x00, 0x00, 0x00, 0x00, 
	0x00, 0x00, 0x00, 0x00, 0x00, 0x00, 0x00, 0x00, 0x00, 0x00, 0x00, 0x00, 0x00, 0x00, 0x00, 0x00, 
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	0x00, 0x00, 0x00, 0x00, 0x00, 0x00, 0x00, 0x00, 0x00, 0x00, 0x00, 0x00, 0x00, 0x00, 0x00, 0x00
};
// TURBO ON ICON - Swap this array with the icon to show when the turbo button is enabled (default Cyrix 486 icon)
const unsigned char turbo_on [] PROGMEM = {
	0x00, 0x00, 0x00, 0x00, 0x00, 0x00, 0x00, 0x00, 0x00, 0x00, 0x00, 0x00, 0x00, 0x00, 0x00, 0x00, 
	0x00, 0x00, 0x00, 0x00, 0x00, 0x00, 0x00, 0x00, 0x00, 0x00, 0x00, 0x00, 0x00, 0x00, 0x00, 0x00, 
	0x00, 0x00, 0x00, 0x00, 0x00, 0x00, 0x00, 0x00, 0x00, 0x00, 0x00, 0x00, 0x00, 0x00, 0x00, 0x00, 
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	0x00, 0x00, 0x00, 0x00, 0x00, 0x00, 0x00, 0x00, 0x00, 0x00, 0x00, 0x00, 0x00, 0x00, 0x00, 0x00
};

// Array of all bitmaps for convenience. (Total bytes used to store images in PROGMEM = 2080)
// If you swap bitmaps above, be sure to swap their names to your new ones in this array
const int epd_bitmap_allArray_LEN = 2;
const unsigned char* epd_bitmap_allArray[2] = {
	turbo_off,
	turbo_on
};


////////////////////////////////////////////////////////////////
//////////////////////////////////////////////////////////////// STAR FIELD SCREENSAVER
//////////////////////////////////////////////////////////////// adapted from https://github.com/sinoia/oled-starfield/
////////////////////////////////////////////////////////////////

const int starCount = 512; // number of stars in the star field
const int maxDepth = 32;   // maximum distance away for a star

// the star field - starCount stars represented as x, y and z co-ordinates
double stars[starCount][3];

int getRandom(int lower, int upper) {
    /* Generate and return a  random number between lower and upper bound */
    return lower + static_cast<int>(rand() % (upper - lower + 1));
}

void drawStars() {
    int origin_x = 128 / 2;
    int origin_y = 64 / 2;

    // Iterate through the stars reducing the z co-ordinate in order to move the
    // star closer.
    for (int i = 0; i < starCount; ++i) {
       stars[i][2] -= 0.76;
       // if the star has moved past the screen (z < 0) reposition it far away
       // with random x and y positions.
       if (stars[i][2] <= 0) {
           stars[i][0] = getRandom(-25, 25);
           stars[i][1] = getRandom(-25, 25);
           stars[i][2] = maxDepth;
       }

       // Convert the 3D coordinates to 2D using perspective projection.
       double k = 128 / stars[i][2];
       int x = static_cast<int>(stars[i][0] * k + origin_x);
       int y = static_cast<int>(stars[i][1] * k + origin_y);

       //  Draw the star (if it is visible in the screen).
       // Distant stars are smaller than closer stars.
       if ((0 <= x and x < 128) 
           and (0 <= y and y < 64)) {
           int size = (1 - stars[i][2] / maxDepth) * 4;
           display.fillRect(x, y, size, size, 1);
       }
    }
}


////////////////////////////////////////////////////////////////
//////////////////////////////////////////////////////////////// MAIN
////////////////////////////////////////////////////////////////

// Begin with an initially impossible Turbo status. This will ensure the correct icon appears when the machine is started as the mode will be forced to switch.
int turboLastStatus = 99;
// Status 0 = Turbo Off, Status 1 = Turbo On
int turboStatus = 0;
// Accumulator of wait cycles to still allow polling for button changes while holding the processor icon on the screen (in cases you toggle in rapid succession)
int waitCycles = 0;

void setup() {
  Serial.begin(9600);

  // SSD1306_SWITCHCAPVCC = generate display voltage from 3.3V internally
  if(!display.begin(SSD1306_SWITCHCAPVCC, SCREEN_ADDRESS)) {
    Serial.println(F("SSD1306 allocation failed"));
    for(;;); // Don't proceed, loop forever
  }

  // initialize the turbo pin
  pinMode(turboPin, INPUT);

  // initialize random stars
  for (int i = 0; i < starCount; i++) {
    stars[i][0] = getRandom(-25, 25);
    stars[i][1] = getRandom(-25, 25);
    stars[i][2] = getRandom(0, maxDepth);
  }

  // Clear the buffer
  display.clearDisplay();
}

void loop() {
  turboStatus = digitalRead(turboPin);

  // if the button status has changed, show the icon for the new status
  if (turboStatus != turboLastStatus) {
    if (turboStatus == 0) {
      turboOff();
    } else if (turboStatus == 1) {
      turboOn();
    }
  }
  turboLastStatus = turboStatus;

  // run up the wait cycles, or swap to screensaver if enough have passed
  if (waitCycles < 1000) {
    delay(showIconFor);
    waitCycles = waitCycles + 1;
  } else {
    display.clearDisplay();
    drawStars();
    display.display();
  }
}

void turboOff() {
  display.clearDisplay();
  display.drawBitmap(0, 0, turbo_off, 128, 64, 1);
  display.display();
  waitCycles = 0;
}

void turboOn() {
  display.clearDisplay();
  display.drawBitmap(0, 0, turbo_on, 128, 64, 1);
  display.display();
  waitCycles = 0;
}

